/dts-v1/;

/ {

	__fixups__ {
		acl_slg = "/fragment@47:target:0", "/fragment@49/__overlay__:def-supply:0";
		auth_battery = "/fragment@49:target:0";
		dispsys_config = "/fragment@10:target:0";
		dsi0 = "/fragment@11:target:0";
		dsi_te = "/fragment@38:target:0";
		goodix_fp = "/fragment@34:target:0";
		gpio = "/fragment@29:target:0";
		gpio_usage_mapping = "/fragment@28:target:0";
		gps = "/fragment@15:target:0";
		i2c0 = "/fragment@1:target:0";
		i2c3 = "/fragment@2:target:0";
		i2c6 = "/fragment@19:target:0", "/fragment@42:target:0", "/fragment@43:target:0";
		i2c7 = "/fragment@25:target:0", "/fragment@27:target:0";
		irq_nfc = "/fragment@30:target:0";
		keypad = "/fragment@41:target:0";
		maxim_ds28e30 = "/fragment@46:target:0", "/fragment@49/__overlay__:def-supply:4";
		md1_sim1_hot_plug_eint = "/fragment@39:target:0";
		md1_sim2_hot_plug_eint = "/fragment@40:target:0";
		memory_ssmr_features = "/fragment@13:target:0";
		mrdump_ext_rst = "/fragment@33:target:0";
		mt6369_vfp = "/fragment@3/__overlay__/fingerprint@0:vfp-supply:0", "/fragment@45/__overlay__:vdd-supply:0";
		mt6369_vtp = "/fragment@1/__overlay__/focaltech@38:vtouch-supply:0", "/fragment@17/__overlay__/gt9896s@0:vtouch-supply:0";
		mtee_svp = "/fragment@12:target:0";
		mtk_leds = "/fragment@7:target:0";
		mtkfb = "/fragment@9:target:0";
		odm = "/fragment@6:target:0", "/fragment@23:target:0";
		onewire_gpio = "/fragment@45:target:0";
		pdc = "/fragment@21:target:0";
		pio = "/fragment@1/__overlay__/focaltech@38:interrupt-parent:0", "/fragment@1/__overlay__/focaltech@38:focaltech,reset-gpio:0", "/fragment@1/__overlay__/focaltech@38:focaltech,irq-gpio:0", "/fragment@2/__overlay__/sn-i2c@28:nxp,sn-ven-rstn:0", "/fragment@2/__overlay__/sn-i2c@28:nxp,sn-dwl-req:0", "/fragment@2/__overlay__/sn-i2c@28:nxp,sn-irq:0", "/fragment@2/__overlay__/sn-i2c@28:interrupt-parent:0", "/fragment@2/__overlay__/sn-i2c@28:tms,irq-gpio:0", "/fragment@2/__overlay__/sn-i2c@28:tms,ven-gpio:0", "/fragment@2/__overlay__/sn-i2c@28:tms,download-gpio:0", "/fragment@3/__overlay__/fingerprint@0:xiaomi,gpio_irq:0", "/fragment@3/__overlay__/fingerprint@0:interrupt-parent:0", "/fragment@4:target:0", "/fragment@5:target:0", "/fragment@6/__overlay__/wifi_ant_check:gpio:0", "/fragment@8:target:0", "/fragment@11/__overlay__/panel1@0:reset-gpios:0", "/fragment@11/__overlay__/panel1@0:vddi-gpios:0", "/fragment@11/__overlay__/panel1@0:vci-gpios:0", "/fragment@11/__overlay__/panel1@0:mi,esd-err-irq-gpio:0", "/fragment@14:target:0", "/fragment@17/__overlay__/gt9896s@0:goodix,reset-gpio:0", "/fragment@17/__overlay__/gt9896s@0:goodix,irq-gpio:0", "/fragment@18:target:0", "/fragment@22:target:0", "/fragment@23/__overlay__/si_pa_R:si,si_pa_reset:0", "/fragment@26:target:0", "/fragment@27/__overlay__/fs1xxx@35:fsm,rst-gpio:0", "/fragment@28/__overlay__:GPIO_SIM1_HOT_PLUG:0", "/fragment@28/__overlay__:GPIO_SIM2_HOT_PLUG:0", "/fragment@28/__overlay__:GPIO_SIM1_SCLK:0", "/fragment@28/__overlay__:GPIO_SIM1_SRST:0", "/fragment@28/__overlay__:GPIO_SIM1_SIO:0", "/fragment@28/__overlay__:GPIO_SIM2_SCLK:0", "/fragment@28/__overlay__:GPIO_SIM2_SRST:0", "/fragment@28/__overlay__:GPIO_SIM2_SIO:0", "/fragment@28/__overlay__:GPIO_FDD_BAND_SUPPORT_DETECT_1ST_PIN:0", "/fragment@30/__overlay__:interrupt-parent:0", "/fragment@31/__overlay__:interrupt-parent:0", "/fragment@31/__overlay__:deb-gpios:0", "/fragment@32/__overlay__:interrupt-parent:0", "/fragment@33/__overlay__:interrupt-parent:0", "/fragment@33/__overlay__:deb-gpios:0", "/fragment@34/__overlay__:interrupt-parent:0", "/fragment@35/__overlay__:interrupt-parent:0", "/fragment@36/__overlay__:interrupt-parent:0", "/fragment@37/__overlay__:interrupt-parent:0", "/fragment@38/__overlay__:interrupt-parent:0", "/fragment@42/__overlay__/sc8541x-charger@6a:sc8541,intr_gpio:0", "/fragment@43/__overlay__/nu2115@m6d:interrupt-parent:0", "/fragment@43/__overlay__/nu2115@m6d:nu2115,intr_gpio:0", "/fragment@44:target:0", "/fragment@45/__overlay__:gpios:0";
		rt5133_eint = "/fragment@36:target:0";
		smart_pa = "/fragment@37:target:0";
		sound = "/fragment@20:target:0", "/fragment@24:target:0";
		spi1 = "/fragment@3:target:0";
		spi3 = "/fragment@17:target:0";
		spi7 = "/fragment@16:target:0";
		st_stick = "/fragment@48:target:0", "/fragment@49/__overlay__:def-supply:8";
		subpmic_pmu_eint = "/fragment@32:target:0";
		swtp = "/fragment@31:target:0";
		touch = "/fragment@35:target:0";
		xiaomi_touch = "/fragment@0:target:0";
	};

	__local_fixups__ {

		fragment@10 {

			__overlay__ {
				pinctrl-0 = <0x0>;
				pinctrl-1 = <0x0>;
				pinctrl-2 = <0x0>;
				pinctrl-3 = <0x0>;
				pinctrl-4 = <0x0>;
				pinctrl-5 = <0x0>;
				pinctrl-6 = <0x0>;
				pinctrl-7 = <0x0>;
			};
		};

		fragment@11 {

			__overlay__ {

				panel1@0 {

					port {

						endpoint {
							remote-endpoint = <0x0>;
						};
					};
				};

				panel2@0 {

					port {

						endpoint {
							remote-endpoint = <0x0>;
						};
					};
				};

				ports {

					port {

						endpoint {
							remote-endpoint = <0x0>;
						};
					};
				};
			};
		};

		fragment@15 {

			__overlay__ {
				pinctrl-0 = <0x0>;
				pinctrl-1 = <0x0>;
				pinctrl-2 = <0x0>;
				pinctrl-3 = <0x0>;
				pinctrl-4 = <0x0>;
				pinctrl-5 = <0x0>;
				pinctrl-6 = <0x0>;
			};
		};

		fragment@17 {

			__overlay__ {
				pinctrl-0 = <0x0>;
				pinctrl-1 = <0x0>;
				pinctrl-2 = <0x0>;
				pinctrl-3 = <0x0>;
				pinctrl-4 = <0x0>;
				pinctrl-5 = <0x0>;
			};
		};

		fragment@23 {

			__overlay__ {

				si_pa_R {
					pinctrl-0 = <0x0>;
				};
			};
		};

		fragment@24 {

			__overlay__ {
				si,sia81xx-aux-devs = <0x0 0x4>;
			};
		};

		fragment@25 {

			__overlay__ {

				sipa_i2c_L@5A {
					si,sipa-dev = <0x0>;
				};

				sipa_i2c_R@29 {
					si,sipa-dev = <0x0>;
				};
			};
		};

		fragment@27 {

			__overlay__ {

				fs1xxx@35 {
					pinctrl-0 = <0x0>;
				};
			};
		};

		fragment@3 {

			__overlay__ {

				fingerprint@0 {
					pinctrl-0 = <0x0>;
					pinctrl-1 = <0x0>;
					pinctrl-2 = <0x0>;
					pinctrl-3 = <0x0>;
					pinctrl-4 = <0x0>;
					pinctrl-5 = <0x0>;
				};
			};
		};

		fragment@45 {

			__overlay__ {
				pinctrl-0 = <0x0>;
			};
		};

		fragment@6 {

			__overlay__ {

				wifi_ant_check {
					pinctrl-0 = <0x0>;
				};
			};
		};

		fragment@9 {

			__overlay__ {
				pinctrl-0 = <0x0>;
				pinctrl-1 = <0x0>;
				pinctrl-2 = <0x0>;
				pinctrl-3 = <0x0>;
				pinctrl-4 = <0x0>;
				pinctrl-5 = <0x0>;
				pinctrl-6 = <0x0>;
				pinctrl-7 = <0x0>;
				pinctrl-8 = <0x0>;
				pinctrl-9 = <0x0>;
			};
		};
	};

	__symbols__ {
		ctp_gt9896s_int_active = "/fragment@18/__overlay__/int1_active";
		ctp_gt9896s_int_suspend = "/fragment@18/__overlay__/int1_suspend";
		ctp_gt9896s_pins_default = "/fragment@18/__overlay__/pins_default";
		ctp_gt9896s_reset_active = "/fragment@18/__overlay__/reset1_active";
		ctp_gt9896s_reset_suspend = "/fragment@18/__overlay__/reset1_suspend";
		ctp_gt9896s_spi_mode = "/fragment@18/__overlay__/spimode_default";
		dsi_out = "/fragment@11/__overlay__/ports/port/endpoint";
		fingerprints_eint_default = "/fragment@4/__overlay__/state_eint_default";
		fingerprints_eint_pulldown = "/fragment@4/__overlay__/state_eint_pulldown";
		fingerprints_reset_high = "/fragment@4/__overlay__/state_reset_high";
		fingerprints_reset_low = "/fragment@4/__overlay__/state_reset_low";
		fingerprints_spiio_gpio_mode = "/fragment@4/__overlay__/state_gpio_mode";
		fingerprints_spiio_spi_mode = "/fragment@4/__overlay__/state_spi_mode";
		fs18xx_gpio_R = "/fragment@26/__overlay__/fs18xx_gpio_R";
		gps_l1_lna_pins_dsp_ctrl = "/fragment@14/__overlay__/gps_l1_lna@1";
		gps_l1_lna_pins_oh = "/fragment@14/__overlay__/gps_l1_lna@2";
		gps_l1_lna_pins_ol = "/fragment@14/__overlay__/gps_l1_lna@0";
		gps_l5_lna_pins_dsp_ctrl = "/fragment@14/__overlay__/gps_l5_lna@1";
		gps_l5_lna_pins_oh = "/fragment@14/__overlay__/gps_l5_lna@2";
		gps_l5_lna_pins_ol = "/fragment@14/__overlay__/gps_l5_lna@0";
		gps_pins_default = "/fragment@14/__overlay__/gps_default";
		mtee = "/fragment@12/__overlay__/MTEE";
		mtkfb_pins_lcm_dsi_te = "/fragment@8/__overlay__/lcm_dsi_te";
		mtkfb_pins_lcm_err_flag = "/fragment@8/__overlay__/lcm_err_flag";
		mtkfb_pins_lcm_led_en0 = "/fragment@8/__overlay__/lcm_led_en0_gpio";
		mtkfb_pins_lcm_led_en1 = "/fragment@8/__overlay__/lcm_led_en1_gpio";
		mtkfb_pins_lcm_rst_out0_gpio = "/fragment@8/__overlay__/lcm_rst_out0_gpio";
		mtkfb_pins_lcm_rst_out1_gpio = "/fragment@8/__overlay__/lcm_rst_out1_gpio";
		mtkfb_pins_lcm_vci3_out0 = "/fragment@8/__overlay__/lcm_vci3_out0_gpio";
		mtkfb_pins_lcm_vci3_out1 = "/fragment@8/__overlay__/lcm_vci3_out1_gpio";
		mtkfb_pins_lcm_vddi18_out0 = "/fragment@8/__overlay__/lcm_vddi18_out0_gpio";
		mtkfb_pins_lcm_vddi18_out1 = "/fragment@8/__overlay__/lcm_vddi18_out1_gpio";
		panel_in1 = "/fragment@11/__overlay__/panel1@0/port/endpoint";
		panel_in2 = "/fragment@11/__overlay__/panel2@0/port/endpoint";
		si_pa_L = "/fragment@23/__overlay__/si_pa_L";
		si_pa_R = "/fragment@23/__overlay__/si_pa_R";
		sia81xx_gpio_R = "/fragment@22/__overlay__/sia81xx_gpio_R";
		sipa_i2c_L = "/fragment@25/__overlay__/sipa_i2c_L@5A";
		sipa_i2c_R = "/fragment@25/__overlay__/sipa_i2c_R@29";
		spidev7 = "/fragment@16/__overlay__/spi@7";
		spk = "/fragment@19/__overlay__/speaker_amp@5c";
		svp = "/fragment@12/__overlay__/SecureVideoPath";
		w1_pins = "/fragment@44/__overlay__/w1_pins";
		wifi_ant_check = "/fragment@5/__overlay__/wifi_ant_check";
	};

	fragment@0 {
		target = <0xffffffff>;

		__overlay__ {
			compatible = "xiaomi-touch";
			status = "okay";
			touch,name = "xiaomi-touch";
		};
	};

	fragment@1 {
		target = <0xffffffff>;

		__overlay__ {

			focaltech@38 {
				compatible = "focaltech,fts";
				focaltech,display-coords = <0x0 0x0 0x437f 0x95ff>;
				focaltech,irq-gpio = <0xffffffff 0x16 0x2>;
				focaltech,max-touch-number = <0xa>;
				focaltech,reset-gpio = <0xffffffff 0x3 0x1>;
				interrupt-parent = <0xffffffff>;
				interrupts = <0x16 0x2>;
				reg = <0x38>;
				status = "okay";
				vtouch-supply = <0xffffffff>;
			};
		};
	};

	fragment@10 {
		target = <0xffffffff>;

		__overlay__ {
			pinctrl-0 = <0xa>;
			pinctrl-1 = <0xb>;
			pinctrl-2 = <0xc>;
			pinctrl-3 = <0xd>;
			pinctrl-4 = <0xe>;
			pinctrl-5 = <0xf>;
			pinctrl-6 = <0x10>;
			pinctrl-7 = <0x11>;
			pinctrl-names = "lcm_rst_out1_gpio", "lcm_rst_out0_gpio", "mode_te_te", "lcm_vddi18_out0_gpio", "lcm_vddi18_out1_gpio", "lcm_vci3_out0_gpio", "lcm_vci3_out1_gpio", "err_flag_init";
			status = "okay";
		};
	};

	fragment@11 {
		target = <0xffffffff>;

		__overlay__ {
			#address-cells = <0x1>;
			#size-cells = <0x0>;
			status = "okay";
			switch_fps = <0x3c>;

			panel1@0 {
				compatible = "dsi_panel_o17_38_0c_0a_fhdp_vdo,lcm";
				mi,esd-err-irq-gpio = <0xffffffff 0xc 0x2002>;
				reg = <0x0>;
				reset-gpios = <0xffffffff 0x5f 0x0>;
				vci-gpios = <0xffffffff 0xb7 0x0>;
				vddi-gpios = <0xffffffff 0xa2 0x0>;

				port {

					endpoint {
						phandle = <0x13>;
						remote-endpoint = <0x12>;
					};
				};
			};

			panel2@0 {
				compatible = "dsi_panel_o17_null_fhdp_vdo,lcm";
				pinctrl-names = "default";
				reg = <0x1>;

				port {

					endpoint {
						phandle = <0x26>;
						remote-endpoint = <0x12>;
					};
				};
			};

			ports {

				port {

					endpoint {
						phandle = <0x12>;
						remote-endpoint = <0x13>;
					};
				};
			};
		};
	};

	fragment@12 {
		target = <0xffffffff>;

		__overlay__ {

			MTEE {
				compatible = "mediatek,mtk_svp_on_mtee_support";
				phandle = <0x27>;
			};

			SecureVideoPath {
				compatible = "mediatek,mtk_sec_video_path_support";
				phandle = <0x28>;
			};
		};
	};

	fragment@13 {
		target = <0xffffffff>;

		__overlay__ {
			svp-page-based-size = <0x0 0x14000000>;
			svp-region-based-size = <0x0 0x2000000>;
		};
	};

	fragment@14 {
		target = <0xffffffff>;

		__overlay__ {

			gps_default {
				phandle = <0x14>;
			};

			gps_l1_lna@0 {
				phandle = <0x15>;

				pins_cmd_dat {
					output-low;
					pinmux = <0x8500>;
				};
			};

			gps_l1_lna@1 {
				phandle = <0x16>;

				pins_cmd_dat {
					pinmux = <0x8503>;
				};
			};

			gps_l1_lna@2 {
				phandle = <0x17>;

				pins_cmd_dat {
					output-high;
					pinmux = <0x8500>;
				};
			};

			gps_l5_lna@0 {
				phandle = <0x18>;

				pins_cmd_dat {
					output-low;
					pinmux = <0x8600>;
				};
			};

			gps_l5_lna@1 {
				phandle = <0x19>;

				pins_cmd_dat {
					pinmux = <0x8603>;
				};
			};

			gps_l5_lna@2 {
				phandle = <0x1a>;

				pins_cmd_dat {
					output-high;
					pinmux = <0x8600>;
				};
			};
		};
	};

	fragment@15 {
		target = <0xffffffff>;

		__overlay__ {
			pinctrl-0 = <0x14>;
			pinctrl-1 = <0x15>;
			pinctrl-2 = <0x16>;
			pinctrl-3 = <0x17>;
			pinctrl-4 = <0x18>;
			pinctrl-5 = <0x19>;
			pinctrl-6 = <0x1a>;
			pinctrl-names = "default", "gps_l1_lna_disable", "gps_l1_lna_dsp_ctrl", "gps_l1_lna_enable", "gps_l5_lna_disable", "gps_l5_lna_dsp_ctrl", "gps_l5_lna_enable";
			status = "okay";
		};
	};

	fragment@16 {
		target = <0xffffffff>;

		__overlay__ {
			status = "okay";

			spi@7 {
				compatible = "ir,ir_spi";
				phandle = <0x29>;
				reg = <0x0>;
				spi-cpol;
				spi-max-frequency = <0xf4240>;
			};
		};
	};

	fragment@17 {
		target = <0xffffffff>;

		__overlay__ {
			#address-cells = <0x1>;
			#size-cells = <0x0>;
			pinctrl-0 = <0x1b>;
			pinctrl-1 = <0x1c>;
			pinctrl-2 = <0x1d>;
			pinctrl-3 = <0x1e>;
			pinctrl-4 = <0x1f>;
			pinctrl-5 = <0x20>;
			pinctrl-names = "default", "gt9896s_int_active", "gt9896s_reset_active", "gt9896s_int_suspend", "gt9896s_reset_suspend", "gt9896s_spi_mode";
			status = "okay";

			gt9896s@0 {
				compatible = "goodix,gt9896s";
				goodix,avdd-name = "vtouch";
				goodix,config-version = "6855v01";
				goodix,firmware-version = "6855v01";
				goodix,input-max-x = <0x438>;
				goodix,input-max-y = <0x960>;
				goodix,irq-flags = <0x2>;
				goodix,irq-gpio = <0xffffffff 0x16 0x0>;
				goodix,panel-key-map = <0x9e 0xac 0xd9>;
				goodix,panel-max-id = <0xa>;
				goodix,panel-max-p = <0x100>;
				goodix,panel-max-w = <0x100>;
				goodix,panel-max-x = <0x438>;
				goodix,panel-max-y = <0x960>;
				goodix,pen-enable;
				goodix,power-off-delay-us = <0x1388>;
				goodix,power-on-delay-us = <0x2710>;
				goodix,reset-gpio = <0xffffffff 0x3 0x0>;
				goodix,x2x;
				goodix,y2y;
				reg = <0x0>;
				spi-max-frequency = <0xf4240>;
				tpd-filter-custom-prameters = <0x0 0x0 0x0 0x0 0x0 0x0 0x0 0x0 0x0 0x0 0x0 0x0>;
				tpd-filter-custom-speed = <0x0 0x0 0x0>;
				tpd-filter-enable = <0x0>;
				tpd-filter-pixel-density = <0xa1>;
				vtouch-supply = <0xffffffff>;
			};
		};
	};

	fragment@18 {
		target = <0xffffffff>;

		__overlay__ {

			int1_active {
				phandle = <0x1c>;

				pins_cmd_dat {
					input-enable;
					pinmux = <0x1600>;
				};
			};

			int1_suspend {
				phandle = <0x1e>;

				pins_cmd_dat {
					output-low;
					pinmux = <0x1600>;
				};
			};

			pins_default {
				phandle = <0x1b>;
			};

			reset1_active {
				phandle = <0x1d>;

				pins_cmd_dat {
					output-high;
					pinmux = <0x300>;
				};
			};

			reset1_suspend {
				phandle = <0x1f>;

				pins_cmd_dat {
					output-low;
					pinmux = <0x300>;
				};
			};

			spimode_default {
				phandle = <0x20>;

				pins_cmd_dat {
					drive-strength = <0x2>;
					pinmux = <0x4902 0x4a02 0x4b02 0x4c02>;
				};
			};
		};
	};

	fragment@19 {
		target = <0xffffffff>;

		__overlay__ {

			speaker_amp@5c {
				#sound-dai-cells = <0x0>;
				compatible = "richtek,rt5512";
				phandle = <0x2a>;
				reg = <0x5c>;
				sound-name-prefix = "Left";
				status = "disabled";
			};
		};
	};

	fragment@2 {
		target = <0xffffffff>;

		__overlay__ {
			clock-frequency = <0x61a80>;
			status = "okay";

			sn-i2c@28 {
				compatible = "nxp,sn-nci";
				interrupt-parent = <0xffffffff>;
				interrupts = <0x2 0x8>;
				nxp,sn-dwl-req = <0xffffffff 0x1 0x0>;
				nxp,sn-irq = <0xffffffff 0x2 0x0>;
				nxp,sn-ven-rstn = <0xffffffff 0x29 0x0>;
				reg = <0x28>;
				status = "okay";
				tms,download-gpio = <0xffffffff 0x1 0x0>;
				tms,irq-gpio = <0xffffffff 0x2 0x0>;
				tms,ven-gpio = <0xffffffff 0x29 0x0>;
			};
		};
	};

	fragment@20 {
		target = <0xffffffff>;

		__overlay__ {
			mediatek,spk-i2s = <0x3 0x0>;
		};
	};

	fragment@21 {
		target = <0xffffffff>;

		__overlay__ {
			pd_vbus_upper_bound = <0x895440>;
		};
	};

	fragment@22 {
		target = <0xffffffff>;

		__overlay__ {

			sia81xx_gpio_R {
				phandle = <0x21>;

				pins_cmd_dat {
					output-low;
					pinmux = <0x8600>;
				};
			};
		};
	};

	fragment@23 {
		target = <0xffffffff>;

		__overlay__ {

			si_pa_L {
				channel_num = <0x0>;
				compatible = "si,sia81xx";
				phandle = <0x22>;
				si,si_pa_disable_pin = <0x1>;
				si,si_pa_type = "sia8152x";
				status = "okay";
			};

			si_pa_R {
				channel_num = <0x1>;
				compatible = "si,sia81xx";
				phandle = <0x23>;
				pinctrl-0 = <0x21>;
				pinctrl-names = "si_pa_gpio";
				si,si_pa_disable_pin = <0x0>;
				si,si_pa_reset = <0xffffffff 0x86 0x0>;
				si,si_pa_type = "sia81x9";
				status = "okay";
			};
		};
	};

	fragment@24 {
		target = <0xffffffff>;

		__overlay__ {
			si,sia81xx-aux-devs = <0x22 0x23>;
			si,sia81xx-aux-devs-prefix = "SpkrMonoL", "SpkrMonoR";
			si,sia81xx-max-num = <0x2>;
		};
	};

	fragment@25 {
		target = <0xffffffff>;

		__overlay__ {

			sipa_i2c_L@5A {
				compatible = "si,sia81xx-i2c";
				phandle = <0x2b>;
				reg = <0x5a>;
				si,sipa-dev = <0x22>;
				status = "okay";
			};

			sipa_i2c_R@29 {
				compatible = "si,sia81xx-i2c";
				phandle = <0x2c>;
				reg = <0x29>;
				si,sipa-dev = <0x23>;
				status = "okay";
			};
		};
	};

	fragment@26 {
		target = <0xffffffff>;

		__overlay__ {

			fs18xx_gpio_R {
				phandle = <0x24>;

				pins_cmd_dat {
					output-low;
					pinmux = <0x8600>;
				};
			};
		};
	};

	fragment@27 {
		target = <0xffffffff>;

		__overlay__ {
			clock-frequency = <0x61a80>;

			fs1xxx@35 {
				compatible = "foursemi,fs1815";
				fsm,rst-gpio = <0xffffffff 0x86 0x0>;
				pinctrl-0 = <0x24>;
				pinctrl-names = "fs18xx_gpio";
				reg = <0x35>;
				status = "ok";
			};

			fs1xxx@36 {
				compatible = "foursemi,fs1599";
				reg = <0x36>;
				status = "ok";
			};
		};
	};

	fragment@28 {
		target = <0xffffffff>;

		__overlay__ {
			GPIO_FDD_BAND_SUPPORT_DETECT_1ST_PIN = <0xffffffff 0x9e 0x0>;
			GPIO_SIM1_HOT_PLUG = <0xffffffff 0x33 0x0>;
			GPIO_SIM1_SCLK = <0xffffffff 0x58 0x0>;
			GPIO_SIM1_SIO = <0xffffffff 0x5a 0x0>;
			GPIO_SIM1_SRST = <0xffffffff 0x59 0x0>;
			GPIO_SIM2_HOT_PLUG = <0xffffffff 0x34 0x0>;
			GPIO_SIM2_SCLK = <0xffffffff 0x5b 0x0>;
			GPIO_SIM2_SIO = <0xffffffff 0x5d 0x0>;
			GPIO_SIM2_SRST = <0xffffffff 0x5c 0x0>;
		};
	};

	fragment@29 {
		target = <0xffffffff>;

		__overlay__ {
			gpio_init_default = <0x0 0x0 0x0 0x0 0x1 0x1 0x1 0x1 0x0 0x1 0x0 0x1 0x0 0x1 0x2 0x0 0x0 0x0 0x1 0x1 0x0 0x3 0x0 0x1 0x0 0x1 0x0 0x1 0x4 0x0 0x0 0x0 0x0 0x0 0x1 0x5 0x0 0x1 0x0 0x1 0x0 0x1 0x6 0x0 0x0 0x0 0x1 0x1 0x1 0x7 0x0 0x0 0x0 0x1 0x1 0x1 0x8 0x1 0x0 0x0 0x1 0x0 0x1 0x9 0x0 0x0 0x0 0x0 0x0 0x1 0xa 0x6 0x0 0x0 0x1 0x0 0x1 0xb 0x6 0x0 0x0 0x1 0x0 0x1 0xc 0x6 0x0 0x0 0x0 0x0 0x1 0xd 0x0 0x0 0x0 0x1 0x1 0x1 0xe 0x0 0x0 0x0 0x1 0x1 0x1 0xf 0x0 0x0 0x0 0x1 0x0 0x1 0x10 0x0 0x0 0x0 0x1 0x0 0x1 0x11 0x0 0x0 0x0 0x1 0x1 0x1 0x12 0x0 0x0 0x0 0x1 0x0 0x1 0x13 0x0 0x0 0x0 0x1 0x0 0x1 0x14 0x4 0x0 0x0 0x0 0x0 0x1 0x15 0x0 0x1 0x0 0x1 0x0 0x1 0x16 0x0 0x0 0x0 0x1 0x1 0x1 0x17 0x0 0x0 0x0 0x1 0x1 0x1 0x18 0x0 0x1 0x0 0x1 0x0 0x1 0x19 0x0 0x0 0x0 0x1 0x0 0x0 0x1a 0x0 0x1 0x0 0x1 0x0 0x1 0x1b 0x0 0x0 0x0 0x1 0x0 0x1 0x1c 0x0 0x0 0x0 0x1 0x0 0x1 0x1d 0x0 0x1 0x0 0x1 0x0 0x1 0x1e 0x0 0x1 0x0 0x1 0x0 0x1 0x1f 0x0 0x1 0x0 0x1 0x0 0x1 0x20 0x0 0x1 0x0 0x1 0x0 0x1 0x21 0x0 0x0 0x0 0x1 0x0 0x1 0x22 0x0 0x0 0x0 0x1 0x0 0x1 0x23 0x3 0x0 0x0 0x1 0x1 0x1 0x24 0x3 0x0 0x0 0x0 0x0 0x1 0x25 0x3 0x0 0x0 0x0 0x0 0x1 0x26 0x3 0x0 0x0 0x1 0x1 0x1 0x27 0x0 0x0 0x0 0x1 0x0 0x1 0x28 0x0 0x0 0x0 0x1 0x0 0x0 0x29 0x0 0x1 0x1 0x1 0x1 0x1 0x2a 0x1 0x0 0x0 0x0 0x0 0x1 0x2b 0x0 0x0 0x0 0x1 0x0 0x0 0x2c 0x0 0x0 0x0 0x1 0x0 0x0 0x2d 0x0 0x0 0x0 0x1 0x0 0x0 0x2e 0x0 0x0 0x0 0x1 0x1 0x1 0x2f 0x1 0x0 0x0 0x0 0x0 0x1 0x30 0x1 0x0 0x0 0x0 0x0 0x1 0x31 0x1 0x0 0x0 0x0 0x0 0x1 0x32 0x3 0x0 0x0 0x1 0x0 0x1 0x33 0x1 0x0 0x0 0x1 0x1 0x1 0x34 0x1 0x0 0x0 0x1 0x1 0x1 0x35 0x1 0x0 0x0 0x0 0x0 0x1 0x36 0x1 0x0 0x0 0x1 0x1 0x1 0x37 0x1 0x0 0x0 0x0 0x0 0x1 0x38 0x1 0x0 0x0 0x1 0x1 0x1 0x39 0x1 0x0 0x0 0x1 0x0 0x1 0x3a 0x0 0x1 0x0 0x1 0x0 0x1 0x3b 0x1 0x0 0x0 0x1 0x1 0x1 0x3c 0x7 0x0 0x0 0x1 0x0 0x1 0x3d 0x7 0x0 0x0 0x1 0x0 0x1 0x3e 0x7 0x0 0x0 0x1 0x0 0x1 0x3f 0x7 0x0 0x0 0x0 0x0 0x1 0x40 0x7 0x0 0x0 0x1 0x0 0x1 0x41 0x2 0x0 0x0 0x0 0x0 0x1 0x42 0x0 0x1 0x0 0x1 0x0 0x1 0x43 0x2 0x0 0x0 0x0 0x0 0x1 0x44 0x2 0x0 0x0 0x1 0x0 0x1 0x45 0x1 0x0 0x0 0x0 0x0 0x1 0x46 0x1 0x0 0x0 0x0 0x0 0x1 0x47 0x1 0x0 0x0 0x0 0x0 0x1 0x48 0x1 0x0 0x0 0x1 0x0 0x1 0x49 0x1 0x0 0x0 0x0 0x0 0x1 0x4a 0x1 0x0 0x0 0x0 0x0 0x1 0x4b 0x1 0x0 0x0 0x0 0x0 0x1 0x4c 0x1 0x0 0x0 0x1 0x0 0x1 0x4d 0x1 0x0 0x0 0x0 0x0 0x1 0x4e 0x1 0x0 0x0 0x0 0x0 0x1 0x4f 0x1 0x0 0x0 0x0 0x0 0x1 0x50 0x1 0x0 0x0 0x1 0x0 0x1 0x52 0x1 0x0 0x0 0x0 0x0 0x1 0x53 0x1 0x0 0x0 0x1 0x1 0x1 0x54 0x1 0x0 0x0 0x1 0x1 0x1 0x55 0x1 0x0 0x0 0x1 0x1 0x1 0x56 0x1 0x0 0x0 0x1 0x1 0x1 0x57 0x1 0x0 0x0 0x1 0x1 0x1 0x58 0x1 0x0 0x0 0x0 0x0 0x1 0x59 0x1 0x0 0x0 0x0 0x0 0x1 0x5a 0x1 0x0 0x0 0x1 0x1 0x1 0x5b 0x1 0x0 0x0 0x0 0x0 0x1 0x5c 0x1 0x0 0x0 0x0 0x0 0x1 0x5d 0x1 0x0 0x0 0x1 0x1 0x1 0x5e 0x1 0x0 0x0 0x1 0x0 0x1 0x5f 0x0 0x1 0x0 0x1 0x0 0x1 0x60 0x1 0x0 0x0 0x0 0x0 0x1 0x61 0x1 0x0 0x0 0x1 0x0 0x1 0x62 0x1 0x0 0x0 0x1 0x0 0x1 0x63 0x1 0x0 0x0 0x1 0x0 0x1 0x64 0x1 0x0 0x0 0x1 0x0 0x1 0x65 0x0 0x0 0x0 0x0 0x0 0x1 0x66 0x0 0x0 0x0 0x0 0x0 0x1 0x67 0x1 0x0 0x0 0x1 0x0 0x1 0x68 0x1 0x0 0x0 0x1 0x0 0x1 0x69 0x1 0x0 0x0 0x0 0x0 0x1 0x6a 0x1 0x0 0x0 0x0 0x0 0x1 0x6b 0x1 0x0 0x0 0x0 0x0 0x1 0x6c 0x1 0x0 0x0 0x0 0x0 0x1 0x6d 0x1 0x0 0x0 0x0 0x0 0x1 0x6e 0x1 0x0 0x0 0x0 0x0 0x1 0x6f 0x1 0x0 0x0 0x0 0x0 0x1 0x70 0x1 0x0 0x0 0x0 0x0 0x1 0x71 0x1 0x0 0x0 0x0 0x0 0x1 0x72 0x1 0x0 0x0 0x0 0x0 0x1 0x73 0x1 0x0 0x0 0x0 0x0 0x1 0x74 0x1 0x0 0x0 0x0 0x0 0x1 0x75 0x1 0x0 0x0 0x0 0x0 0x1 0x76 0x1 0x0 0x0 0x0 0x0 0x1 0x77 0x1 0x0 0x0 0x0 0x0 0x1 0x78 0x1 0x0 0x0 0x0 0x0 0x1 0x79 0x1 0x0 0x0 0x0 0x0 0x1 0x7a 0x1 0x0 0x0 0x0 0x0 0x1 0x7b 0x1 0x0 0x0 0x0 0x0 0x1 0x7c 0x1 0x0 0x0 0x0 0x0 0x1 0x7d 0x1 0x0 0x0 0x0 0x0 0x1 0x7e 0x1 0x0 0x0 0x0 0x0 0x1 0x7f 0x1 0x0 0x0 0x0 0x0 0x0 0x80 0x1 0x0 0x0 0x1 0x0 0x0 0x81 0x1 0x0 0x0 0x0 0x0 0x0 0x82 0x1 0x0 0x0 0x1 0x0 0x0 0x83 0x1 0x0 0x0 0x0 0x0 0x0 0x84 0x1 0x0 0x0 0x1 0x0 0x0 0x85 0x3 0x0 0x0 0x1 0x0 0x1 0x86 0x0 0x1 0x0 0x1 0x0 0x1 0x87 0x1 0x0 0x0 0x1 0x0 0x1 0x88 0x1 0x0 0x0 0x1 0x0 0x1 0x89 0x1 0x0 0x0 0x1 0x1 0x1 0x8a 0x1 0x0 0x0 0x1 0x1 0x1 0x8b 0x2 0x0 0x0 0x1 0x1 0x1 0x8c 0x2 0x0 0x0 0x1 0x1 0x1 0x8d 0x1 0x0 0x0 0x1 0x1 0x1 0x8e 0x1 0x0 0x0 0x1 0x1 0x1 0x8f 0x1 0x0 0x0 0x1 0x1 0x1 0x90 0x1 0x0 0x0 0x1 0x1 0x1 0x91 0x1 0x0 0x0 0x1 0x1 0x1 0x92 0x1 0x0 0x0 0x1 0x1 0x1 0x93 0x1 0x0 0x0 0x1 0x1 0x1 0x94 0x1 0x0 0x0 0x1 0x1 0x1 0x95 0x1 0x0 0x0 0x1 0x1 0x1 0x96 0x1 0x0 0x0 0x1 0x1 0x1 0x97 0x1 0x0 0x0 0x1 0x1 0x1 0x98 0x1 0x0 0x0 0x1 0x1 0x1 0x99 0x1 0x0 0x0 0x1 0x1 0x1 0x9a 0x1 0x0 0x0 0x1 0x1 0x1 0x9b 0x3 0x0 0x0 0x1 0x1 0x1 0x9c 0x3 0x0 0x0 0x1 0x1 0x1 0x9d 0x0 0x1 0x0 0x1 0x0 0x1 0x9e 0x0 0x0 0x0 0x0 0x0 0x1 0x9f 0x5 0x0 0x0 0x1 0x1 0x1 0xa0 0x3 0x0 0x0 0x1 0x0 0x0 0xa1 0x0 0x1 0x0 0x1 0x0 0x1 0xa2 0x0 0x1 0x0 0x1 0x0 0x1 0xa3 0x1 0x0 0x0 0x0 0x0 0x1 0xa4 0x1 0x0 0x0 0x0 0x0 0x1 0xa5 0x1 0x0 0x0 0x0 0x0 0x1 0xa6 0x1 0x0 0x0 0x0 0x0 0x1 0xa7 0x1 0x0 0x0 0x0 0x0 0x1 0xa8 0x1 0x0 0x0 0x0 0x0 0x1 0xa9 0x1 0x0 0x0 0x0 0x0 0x1 0xaa 0x1 0x0 0x0 0x1 0x0 0x1 0xab 0x1 0x0 0x0 0x0 0x0 0x1 0xac 0x1 0x0 0x0 0x0 0x0 0x1 0xad 0x1 0x0 0x0 0x0 0x0 0x1 0xae 0x1 0x0 0x0 0x0 0x0 0x1 0xaf 0x1 0x0 0x0 0x0 0x0 0x1 0xb0 0x1 0x0 0x0 0x0 0x0 0x1 0xb1 0x1 0x0 0x0 0x0 0x0 0x1 0xb2 0x1 0x0 0x0 0x0 0x0 0x1 0xb3 0x1 0x0 0x0 0x1 0x0 0x1 0xb4 0x1 0x0 0x0 0x1 0x0 0x1 0xb5 0x1 0x0 0x0 0x1 0x0 0x1 0xb6 0x0 0x0 0x0 0x0 0x0 0x1 0xb7 0x0 0x1 0x0 0x1 0x0 0x1 0xb8 0x0 0x0 0x0 0x1 0x0 0x1 0xb9 0x0 0x0 0x0 0x1 0x0 0x1 0xba 0x0 0x0 0x0 0x1 0x0 0x1 0xbb 0x0 0x0 0x0 0x1 0x0 0x1 0xbc 0x0 0x0 0x0 0x1 0x0 0x1 0xbd 0x0 0x0 0x0 0x1 0x0 0x1 0xbe 0x0 0x0 0x0 0x1 0x0 0x1 0xbf 0x0 0x0 0x0 0x1 0x0 0x1 0xc0 0x0 0x0 0x0 0x1 0x0 0x1 0xc1 0x1 0x0 0x0 0x0 0x0 0x1 0xc2 0x1 0x0 0x0 0x0 0x0 0x1 0xc3 0x1 0x0 0x0 0x0 0x0 0x1 0xc4 0x1 0x0 0x0 0x1 0x1 0x1 0xc5 0x1 0x0 0x0 0x0 0x0 0x1 0xc6 0x1 0x0 0x0 0x1 0x1 0x1 0xc7 0x1 0x0 0x0 0x1 0x1 0x1 0xc8 0x1 0x0 0x0 0x1 0x1 0x1 0xc9 0x1 0x0 0x0 0x1 0x1 0x1 0xca 0x1 0x0 0x0 0x1 0x1 0x1 0xcb 0x1 0x0 0x0 0x1 0x1 0x1 0xcc 0x1 0x0 0x0 0x1 0x1 0x1 0xcd 0x1 0x0 0x0 0x1 0x1 0x1 0xce 0x0 0x0 0x0 0x1 0x0 0x0 0xcf 0x0 0x0 0x0 0x1 0x0 0x0 0xd0 0x0 0x0 0x0 0x1 0x0 0x0 0xd1 0x0 0x0 0x0 0x1 0x0 0x0 0xd2 0x0 0x0 0x0 0x1 0x0 0x0 0xd3 0x0 0x0 0x0 0x1 0x0 0x0 0xd4 0x0 0x0 0x0 0x1 0x0 0x0 0xd5 0x0 0x0 0x0 0x1 0x0 0x0 0xd6 0x0 0x0 0x0 0x1 0x0 0x0 0xd7 0x0 0x0 0x0 0x1 0x0 0x0 0xd8 0x0 0x0 0x0 0x1 0x0 0x0 0xd9 0x0 0x0 0x0 0x1 0x0 0x0 0xda 0x0 0x0 0x0 0x1 0x0 0x0 0xdb 0x0 0x0 0x0 0x1 0x0 0x0 0xdc 0x0 0x0 0x0 0x1 0x0 0x0 0xdd 0x0 0x0 0x0 0x1 0x0 0x0 0xde 0x0 0x0 0x0 0x1 0x0 0x0 0xdf 0x0 0x0 0x0 0x1 0x0 0x0 0xe0 0x0 0x0 0x0 0x1 0x0 0x0 0xe1 0x0 0x0 0x0 0x1 0x0 0x0>;
		};
	};

	fragment@3 {
		target = <0xffffffff>;

		__overlay__ {
			#address-cells = <0x1>;
			#size-cells = <0x0>;

			fingerprint@0 {
				compatible = "xiaomi,xiaomi-fp";
				interrupt-parent = <0xffffffff>;
				netlink-event = <0x1d>;
				pinctrl-0 = <0x1>;
				pinctrl-1 = <0x2>;
				pinctrl-2 = <0x3>;
				pinctrl-3 = <0x4>;
				pinctrl-4 = <0x5>;
				pinctrl-5 = <0x6>;
				pinctrl-names = "spiio_gpio_mode", "spiio_spi_mode", "reset_high", "reset_low", "eint_default", "eint_pulldown";
				power-type = <0x1>;
				reg = <0x0>;
				spi-max-frequency = <0x7a1200>;
				status = "okay";
				vfp-supply = <0xffffffff>;
				xiaomi,gpio_irq = <0xffffffff 0xf 0x0>;
			};
		};
	};

	fragment@30 {
		target = <0xffffffff>;

		__overlay__ {
			interrupt-parent = <0xffffffff>;
			interrupts = <0x2 0x8>;
			status = "okay";
		};
	};

	fragment@31 {
		target = <0xffffffff>;

		__overlay__ {
			deb-gpios = <0xffffffff 0x4 0x0>;
			debounce = <0x7d000>;
			interrupt-parent = <0xffffffff>;
			interrupts = <0x4 0x8>;
			status = "okay";
		};
	};

	fragment@32 {
		target = <0xffffffff>;

		__overlay__ {
			interrupt-parent = <0xffffffff>;
			interrupts = <0x7 0x8>;
			status = "okay";
		};
	};

	fragment@33 {
		target = <0xffffffff>;

		__overlay__ {
			deb-gpios = <0xffffffff 0xd 0x0>;
			debounce = <0x7d000>;
			interrupt-parent = <0xffffffff>;
			interrupts = <0xd 0x8>;
			status = "okay";
		};
	};

	fragment@34 {
		target = <0xffffffff>;

		__overlay__ {
			interrupt-parent = <0xffffffff>;
			interrupts = <0xf 0x8>;
			status = "okay";
		};
	};

	fragment@35 {
		target = <0xffffffff>;

		__overlay__ {
			interrupt-parent = <0xffffffff>;
			interrupts = <0x16 0x2>;
			status = "okay";
		};
	};

	fragment@36 {
		target = <0xffffffff>;

		__overlay__ {
			interrupt-parent = <0xffffffff>;
			interrupts = <0x17 0x2>;
			status = "okay";
		};
	};

	fragment@37 {
		target = <0xffffffff>;

		__overlay__ {
			interrupt-parent = <0xffffffff>;
			interrupts = <0x2e 0x8>;
			status = "okay";
		};
	};

	fragment@38 {
		target = <0xffffffff>;

		__overlay__ {
			interrupt-parent = <0xffffffff>;
			interrupts = <0x5e 0x1>;
			status = "okay";
		};
	};

	fragment@39 {
		target = <0xffffffff>;

		__overlay__ {
			compatible = "mediatek,md1_sim1_hot_plug_eint-eint";
			debounce = <0x0 0x2710>;
			dedicated = <0x0 0x0>;
			interrupts = <0x0 0x8>;
			sockettype = <0x0 0x0>;
			src_pin = <0x0 0x1>;
			status = "okay";
		};
	};

	fragment@4 {
		target = <0xffffffff>;

		__overlay__ {

			state_eint_default {
				phandle = <0x5>;

				pins_cmd_dat {
					bias-disable;
					input-enable;
					input-schmitt-enable;
					pinmux = <0xf00>;
					slew-rate = <0x0>;
				};
			};

			state_eint_pulldown {
				phandle = <0x6>;

				pins_cmd_dat {
					bias-pull-down;
					input-enable;
					input-schmitt-enable;
					pinmux = <0xf00>;
					slew-rate = <0x0>;
				};
			};

			state_gpio_mode {
				phandle = <0x1>;

				pins_cmd2_dat {
					bias-disable;
					drive-strength = <0x6>;
					input-enable;
					pinmux = <0x4200>;
				};

				pins_cmd3_dat {
					bias-disable;
					drive-strength = <0x6>;
					input-enable;
					pinmux = <0x4300>;
				};

				pins_cmd4_dat {
					bias-disable;
					drive-strength = <0x6>;
					input-enable;
					pinmux = <0x4400>;
				};

				pins_cmd_dat {
					bias-disable;
					drive-strength = <0x6>;
					input-enable;
					pinmux = <0x4100>;
				};
			};

			state_reset_high {
				phandle = <0x3>;

				pins_cmd_dat {
					output-high;
					pinmux = <0x9d00>;
					slew-rate = <0x1>;
				};
			};

			state_reset_low {
				phandle = <0x4>;

				pins_cmd_dat {
					output-low;
					pinmux = <0x9d00>;
					slew-rate = <0x1>;
				};
			};

			state_spi_mode {
				phandle = <0x2>;

				pins_cmd2_dat {
					bias-disable;
					drive-strength = <0x6>;
					input-enable;
					pinmux = <0x4202>;
				};

				pins_cmd3_dat {
					bias-disable;
					drive-strength = <0x6>;
					input-enable;
					pinmux = <0x4302>;
				};

				pins_cmd4_dat {
					bias-disable;
					drive-strength = <0x6>;
					input-enable;
					pinmux = <0x4402>;
				};

				pins_cmd_dat {
					bias-disable;
					drive-strength = <0x6>;
					input-enable;
					pinmux = <0x4102>;
				};
			};
		};
	};

	fragment@40 {
		target = <0xffffffff>;

		__overlay__ {
			compatible = "mediatek,md1_sim2_hot_plug_eint-eint";
			debounce = <0x1 0x2710>;
			dedicated = <0x1 0x0>;
			interrupts = <0x1 0x8>;
			sockettype = <0x1 0x0>;
			src_pin = <0x1 0x2>;
			status = "okay";
		};
	};

	fragment@41 {
		target = <0xffffffff>;

		__overlay__ {
			mediatek,hw-dl-key0 = <0x11>;
			mediatek,hw-dl-key1 = <0x0>;
			mediatek,hw-dl-key2 = <0x8>;
			mediatek,hw-factory-key = <0x0>;
			mediatek,hw-init-map = <0x72 0x0 0x0 0x0 0x0 0x0 0x0 0x0 0x0 0x0 0x0 0x0 0x0 0x0 0x0 0x0 0x0 0x0 0x0 0x0 0x0 0x0 0x0 0x0 0x0 0x0 0x0 0x0 0x0 0x0 0x0 0x0 0x0 0x0 0x0 0x0 0x0 0x0 0x0 0x0 0x0 0x0 0x0 0x0 0x0 0x0 0x0 0x0 0x0 0x0 0x0 0x0 0x0 0x0 0x0 0x0 0x0 0x0 0x0 0x0 0x0 0x0 0x0 0x0 0x0 0x0 0x0 0x0 0x0 0x0 0x0 0x0>;
			mediatek,hw-map-num = <0x48>;
			mediatek,hw-pwrkey = <0x8>;
			mediatek,hw-recovery-key = <0x11>;
			mediatek,hw-rstkey = <0x11>;
			mediatek,key-debounce = <0x400>;
			mediatek,pwkey-gpio-din = <0x0>;
			mediatek,pwrkey-eint-gpio = <0x0>;
			mediatek,sw-pwrkey = <0x74>;
			mediatek,sw-rstkey = <0x73>;
			mediatek,use-extend-type = <0x0>;
			status = "okay";
		};
	};

	fragment@42 {
		target = <0xffffffff>;

		__overlay__ {

			sc8541x-charger@6a {
				charger_name = "primary_dvchg";
				compatible = "sc,sc8541-standalone";
				reg = <0x6a>;
				sc,sc8541,fsw-set = <0x4>;
				sc,sc8541,ibat-ocp = <0x51>;
				sc,sc8541,ibat-ocp-alm = <0x50>;
				sc,sc8541,ibat-ocp-alm-dis = <0x1>;
				sc,sc8541,ibat-ocp-dis = <0x0>;
				sc,sc8541,ibat-sns-r = <0x0>;
				sc,sc8541,ibus-ocp = <0xd>;
				sc,sc8541,ibus-ocp-dis = <0x0>;
				sc,sc8541,ibus-ucp-dis = <0x0>;
				sc,sc8541,ibus-ucp-fall-dg = <0x1>;
				sc,sc8541,ms = <0x0>;
				sc,sc8541,pmid2out-ovp = <0x7>;
				sc,sc8541,pmid2out-uvp = <0x7>;
				sc,sc8541,ss-timeout = <0x7>;
				sc,sc8541,tdie-alm = <0xc8>;
				sc,sc8541,tsbat-flt = <0x15>;
				sc,sc8541,tsbat-flt-dis = <0x1>;
				sc,sc8541,tsbus-flt = <0x15>;
				sc,sc8541,tsbus-flt-dis = <0x1>;
				sc,sc8541,tshut-dis = <0x1>;
				sc,sc8541,vac1-ovp = <0x3>;
				sc,sc8541,vac1-pd-en = <0x0>;
				sc,sc8541,vac2-ovp = <0x3>;
				sc,sc8541,vac2-pd-en = <0x0>;
				sc,sc8541,vbat-ovp = <0x5a>;
				sc,sc8541,vbat-ovp-alm = <0x46>;
				sc,sc8541,vbat-ovp-alm-dis = <0x1>;
				sc,sc8541,vbat-ovp-dis = <0x0>;
				sc,sc8541,vbus-in-range-dis = <0x0>;
				sc,sc8541,vbus-ovp = <0x64>;
				sc,sc8541,vbus-ovp-alm = <0x50>;
				sc,sc8541,vbus-ovp-alm-dis = <0x1>;
				sc,sc8541,vbus-pd-en = <0x0>;
				sc,sc8541,vout-ovp = <0x3>;
				sc,sc8541,vout-ovp-dis = <0x0>;
				sc,sc8541,wd-timeout = <0x0>;
				sc,sc8541,wd-timeout-dis = <0x1>;
				sc8541,intr_gpio = <0xffffffff 0x0 0x0>;
				status = "okay";
			};
		};
	};

	fragment@43 {
		target = <0xffffffff>;

		__overlay__ {

			nu2115@m6d {
				charger_name = "primary_dvchg";
				charger_name_v4_19 = "primary_divider_chg";
				compatible = "nuvolta,nu2115-standalone";
				interrupt-parent = <0xffffffff>;
				interrupts = <0x0 0x0>;
				nu2115,intr_gpio = <0xffffffff 0x0 0x0>;
				nuvolta,nu2115,ac-ovp-threshold = <0x32c8>;
				nuvolta,nu2115,bat-ocp-disable = <0x1>;
				nuvolta,nu2115,bat-ocp-threshold = <0x1f40>;
				nuvolta,nu2115,bat-ovp-disable = <0x0>;
				nuvolta,nu2115,bat-ovp-threshold = <0x11df>;
				nuvolta,nu2115,bus-ocp-alarm-threshold = <0xdac>;
				nuvolta,nu2115,bus-ocp-disable = <0x0>;
				nuvolta,nu2115,bus-ocp-threshold = <0xea6>;
				nuvolta,nu2115,bus-ovp-alarm-threshold = <0x300c>;
				nuvolta,nu2115,bus-ovp-threshold = <0x300c>;
				nuvolta,nu2115,sense-resistor-mohm = <0x5>;
				reg = <0x6d>;
				status = "okay";
			};
		};
	};

	fragment@44 {
		target = <0xffffffff>;

		__overlay__ {

			w1_pins {
				phandle = <0x25>;

				pins_cmd_dat {
					drive-strength = <0x7>;
					output-high;
					pinmux = <0x1900>;
				};
			};
		};
	};

	fragment@45 {
		target = <0xffffffff>;

		__overlay__ {
			compatible = "xiaomi,onewire_gpio";
			gpios = <0xffffffff 0x19 0x0>;
			max-volt = <0x325aa0>;
			min-volt = <0x325aa0>;
			pinctrl-0 = <0x25>;
			pinctrl-names = "default";
			status = "okay";
			vdd-supply = <0xffffffff>;
		};
	};

	fragment@46 {
		target = <0xffffffff>;

		__overlay__ {
			auth_name = "third_supplier";
			compatible = "maxim,ds28e30";
			status = "okay";
		};
	};

	fragment@47 {
		target = <0xffffffff>;

		__overlay__ {
			auth_name = "main_suppiler";
			compatible = "acl,slg";
			status = "okay";
		};
	};

	fragment@48 {
		target = <0xffffffff>;

		__overlay__ {
			auth_name = "second_supplier";
			compatible = "st,stick";
			status = "okay";
		};
	};

	fragment@49 {
		target = <0xffffffff>;

		__overlay__ {
			compatible = "lc,auth-battery";
			def-supply = <0xffffffff 0xffffffff 0xffffffff>;
			status = "okay";
		};
	};

	fragment@5 {
		target = <0xffffffff>;

		__overlay__ {

			wifi_ant_check {
				phandle = <0x7>;

				pins_cmd_dat {
					bias-disable;
					drive-strength = <0x2>;
					input-enable;
					pinmux = <0x900>;
				};
			};
		};
	};

	fragment@6 {
		target = <0xffffffff>;

		__overlay__ {

			wifi_ant_check {
				compatible = "wifi_ant_check";
				debounce-time = <0x1e>;
				gpio = <0xffffffff 0x9 0x0>;
				pinctrl-0 = <0x7>;
				pinctrl-names = "default";
			};
		};
	};

	fragment@7 {
		target = <0xffffffff>;

		__overlay__ {
			compatible = "mediatek,disp-leds";

			backlight {
				gate_enable = <0x1>;
				led-bit = <0xc>;
				led_mode = <0x4>;
				max-brightness = <0xfff>;
				max-hw-brightness = <0xfff>;
				min-brightness = <0x1>;
				pwm_config = <0x0 0x1 0x0 0x0 0x0>;
				trans-bits = <0xc>;
			};
		};
	};

	fragment@8 {
		target = <0xffffffff>;

		__overlay__ {

			lcm_dsi_te {
				phandle = <0xc>;

				pins_cmd_dat {
					pinmux = <0x5e01>;
				};
			};

			lcm_err_flag {
				phandle = <0x11>;

				pins_cmd_dat {
					bias-disable;
					pinmux = <0xc00>;
					slew-rate = <0x0>;
				};
			};

			lcm_led_en0_gpio {
				phandle = <0x9>;

				pins_cmd_dat {
					output-low;
					pinmux = <0xa100>;
					slew-rate = <0x1>;
				};
			};

			lcm_led_en1_gpio {
				phandle = <0x8>;

				pins_cmd_dat {
					output-high;
					pinmux = <0xa100>;
					slew-rate = <0x1>;
				};
			};

			lcm_rst_out0_gpio {
				phandle = <0xb>;

				pins_cmd_dat {
					output-low;
					pinmux = <0x5f00>;
					slew-rate = <0x1>;
				};
			};

			lcm_rst_out1_gpio {
				phandle = <0xa>;

				pins_cmd_dat {
					output-high;
					pinmux = <0x5f00>;
					slew-rate = <0x1>;
				};
			};

			lcm_vci3_out0_gpio {
				phandle = <0xf>;

				pins_cmd_dat {
					output-low;
					pinmux = <0xb700>;
					slew-rate = <0x1>;
				};
			};

			lcm_vci3_out1_gpio {
				phandle = <0x10>;

				pins_cmd_dat {
					output-high;
					pinmux = <0xb700>;
					slew-rate = <0x1>;
				};
			};

			lcm_vddi18_out0_gpio {
				phandle = <0xd>;

				pins_cmd_dat {
					output-low;
					pinmux = <0xa200>;
					slew-rate = <0x1>;
				};
			};

			lcm_vddi18_out1_gpio {
				phandle = <0xe>;

				pins_cmd_dat {
					output-high;
					pinmux = <0xa200>;
					slew-rate = <0x1>;
				};
			};
		};
	};

	fragment@9 {
		target = <0xffffffff>;

		__overlay__ {
			pinctrl-0 = <0x8>;
			pinctrl-1 = <0x9>;
			pinctrl-2 = <0xa>;
			pinctrl-3 = <0xb>;
			pinctrl-4 = <0xc>;
			pinctrl-5 = <0xd>;
			pinctrl-6 = <0xe>;
			pinctrl-7 = <0xf>;
			pinctrl-8 = <0x10>;
			pinctrl-9 = <0x11>;
			pinctrl-names = "lcm_led_en1_gpio", "lcm_led_en0_gpio", "lcm_rst_out1_gpio", "lcm_rst_out0_gpio", "mode_te_te", "lcm_vddi18_out0_gpio", "lcm_vddi18_out1_gpio", "lcm_vci3_out0_gpio", "lcm_vci3_out1_gpio", "err_flag_init";
			status = "okay";
		};
	};
};
